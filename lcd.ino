#include <Adafruit_GFX.h>
#include <Adafruit_PCD8544.h>

// pin 8 - Serial clock out (SCLK)
// pin 7 - Serial data out (DIN)
// pin 6 - Data/Command select (D/C)
// pin 5 - LCD chip select (CS)
// pin 4 - LCD reset (RST)
Adafruit_PCD8544 lcd = Adafruit_PCD8544(8, 7, 6, 5, 4);

static unsigned char PROGMEM vwLogo[] = {
0x00, 0x00, 0x1F, 0xF8, 0x00, 0x00, 0x00, 0x00, 0xFF, 0xFF, 0x00, 0x00, 0x00, 0x03, 0xFC, 0x3F,
0xC0, 0x00, 0x00, 0x1F, 0x80, 0x01, 0xF8, 0x00, 0x00, 0x3E, 0x00, 0x00, 0x7C, 0x00, 0x00, 0x78,
0x00, 0x00, 0x1E, 0x00, 0x00, 0xE0, 0x00, 0x00, 0x07, 0x80, 0x01, 0xC0, 0x0F, 0xF0, 0x03, 0x80,
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0xF8, 0x1F, 0xE0, 0x00, 0x00, 0x00, 0xFF, 0xFF, 0x80, 0x00, 0x00, 0x00, 0x1F, 0xFC, 0x00, 0x00
};

static unsigned char PROGMEM alertBitmap[] = {
0x00, 0x18, 0x00, 0x00, 0x3C, 0x00, 0x00, 0x3C, 0x00, 0x00, 0x7E, 0x00, 0x00, 0xE7, 0x00, 0x00,
0xC3, 0x00, 0x01, 0xC3, 0x80, 0x01, 0x99, 0x80, 0x03, 0x99, 0xC0, 0x03, 0x18, 0xC0, 0x06, 0x18,
0x60, 0x0E, 0x18, 0x70, 0x0C, 0x00, 0x30, 0x1C, 0x00, 0x38, 0x18, 0x00, 0x18, 0x30, 0x18, 0x1C,
0x70, 0x18, 0x0E, 0x60, 0x00, 0x06, 0xE0, 0x00, 0x07, 0xFF, 0xFF, 0xFF, 0xFF, 0xFF, 0xFF, 
};

static unsigned char PROGMEM water_pump_on[] = {
0xFF, 0xFF, 0xFF, 0xFF, 0xFF, 0xFF, 0xFF, 0xFF, 0xC0, 0x00, 0x00, 0x03, 0xC0, 0x00, 0x00, 0x03,
0xC0, 0x00, 0x00, 0x03, 0xC0, 0x00, 0x00, 0x03, 0xC0, 0x00, 0x00, 0x03, 0xC0, 0xF8, 0x61, 0xF3,
0xC1, 0xFF, 0xFF, 0xFB, 0xC1, 0xFF, 0xFF, 0xFB, 0xC1, 0xFF, 0xFF, 0xFB, 0xC0, 0xFC, 0xF3, 0xF3,
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0xC0, 0x00, 0x00, 0x03, 0xC0, 0x00, 0x00, 0x03, 0xFF, 0xFF, 0xFF, 0xFF, 0xFF, 0xFF, 0xFF, 0xFF
};
  
static unsigned char PROGMEM refridgerator[] = {
0xFF, 0xFF, 0xFF, 0xFF, 0xFF, 0xFF, 0xFF, 0xFF, 0xC0, 0x00, 0x01, 0xF3, 0xC0, 0x00, 0x01, 0xF3,
0xC0, 0x00, 0x00, 0x03, 0xC0, 0x00, 0x00, 0x03, 0xC0, 0x00, 0x00, 0x03, 0xC0, 0x01, 0x80, 0x03,
0xC0, 0x01, 0x80, 0x03, 0xC0, 0x0D, 0xB0, 0x03, 0xC0, 0x1F, 0xF8, 0x03, 0xC0, 0xCF, 0xF3, 0x03,
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0xC0, 0x00, 0x00, 0x03, 0xC0, 0x00, 0x00, 0x03, 0xFF, 0xFF, 0xFF, 0xFF, 0xFF, 0xFF, 0xFF, 0xFF
};

static unsigned char PROGMEM refridgerator_open[] = {
0xFF, 0xFF, 0xFF, 0xFF, 0xFF, 0xFF, 0xFF, 0xFF, 0xCF, 0xE0, 0x00, 0x03, 0xC0, 0xFC, 0x00, 0x03,
0xC0, 0x1F, 0xC0, 0x03, 0xC0, 0x01, 0xF8, 0x03, 0xC0, 0x00, 0x3F, 0x83, 0xC0, 0x00, 0x0F, 0xF3,
0xC0, 0x00, 0x0F, 0xF3, 0xC0, 0x00, 0x03, 0xB3, 0xC0, 0x00, 0x00, 0x33, 0xC0, 0x06, 0x00, 0x33,
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0x00, 0x01, 0xF8, 0x30, 0x00, 0x00, 0x3F, 0xB0, 0x00, 0x00, 0x03, 0xF0, 0x00, 0x00, 0x00, 0x70
};

static unsigned char PROGMEM running1[] = {
0x00, 0x08, 0x00, 0x00, 0x0C, 0x00, 0x00, 0x3E, 0x00, 0x01, 0xFF, 0x80, 0x03, 0xFF, 0x80, 0x07,
0xFF, 0x00, 0x0F, 0xCE, 0x70, 0x1F, 0x08, 0xF0, 0x1E, 0x00, 0x78, 0x1E, 0x00, 0x78, 0x00, 0x00,
0x38, 0x30, 0x00, 0x3C, 0x3C, 0x00, 0x3C, 0x3F, 0x00, 0x38, 0x3F, 0x01, 0xF8, 0x3E, 0x01, 0xF8,
0x3F, 0x01, 0xF0, 0x0F, 0xC1, 0xFC, 0x07, 0xFC, 0xF8, 0x03, 0xFC, 0xE0, 0x00, 0xFC, 0x00, 0x00,
0x00, 0x00, 0x00, 0x00, 0x00, 0x00, 0x00, 0x00, 
};

static unsigned char PROGMEM running2[] = {
0x00, 0x00, 0x00, 0x00, 0x00, 0x00, 0x01, 0xF8, 0x00, 0x01, 0xFB, 0x80, 0x03, 0xF3, 0xC0, 0x07,
0xF3, 0xE0, 0x0F, 0xE3, 0xF0, 0x0F, 0x60, 0xF8, 0x1E, 0x00, 0x78, 0x1E, 0x00, 0x78, 0x1C, 0x00,
0x3C, 0x1C, 0x00, 0x3C, 0x1C, 0x00, 0xFF, 0x1C, 0x00, 0x7E, 0x00, 0x00, 0x7C, 0x03, 0xC0, 0x38,
0x0F, 0xC0, 0x98, 0x0F, 0xC3, 0xC0, 0x0F, 0xFF, 0xC0, 0x07, 0xFF, 0xC0, 0x06, 0xFF, 0x00, 0x02,
0x18, 0x00, 0x00, 0x00, 0x00, 0x00, 0x00, 0x00, 
};

static unsigned char PROGMEM running3[] = {
0x00, 0x00, 0x00, 0x00, 0x00, 0x00, 0x00, 0x00, 0x00, 0x00, 0x3F, 0x00, 0x07, 0x3F, 0xC0, 0x1F,
0x3F, 0xE0, 0x3F, 0x83, 0xF0, 0x0F, 0x80, 0xFC, 0x1F, 0x80, 0x7C, 0x1F, 0x80, 0xFC, 0x1C, 0x00,
0xFC, 0x3C, 0x00, 0x3C, 0x3C, 0x00, 0x0C, 0x1C, 0x00, 0x00, 0x1E, 0x00, 0x78, 0x1E, 0x00, 0x78,
0x0F, 0x10, 0xF8, 0x0E, 0x73, 0xF0, 0x00, 0xFF, 0xE0, 0x01, 0xFF, 0xC0, 0x01, 0xFF, 0x80, 0x00,
0x7C, 0x00, 0x00, 0x30, 0x00, 0x00, 0x10, 0x00, 
};
  
static unsigned char PROGMEM running4[] = {
0x00, 0x00, 0x00, 0x00, 0x00, 0x00, 0x00, 0x18, 0x40, 0x00, 0xFF, 0x60, 0x03, 0xFF, 0xE0, 0x03,
0xFF, 0xF0, 0x03, 0xC3, 0xF0, 0x19, 0x03, 0xF0, 0x1C, 0x03, 0xC0, 0x3E, 0x00, 0x00, 0x7E, 0x00,
0x38, 0xFF, 0x00, 0x38, 0x3C, 0x00, 0x38, 0x3C, 0x00, 0x38, 0x1E, 0x00, 0x78, 0x1E, 0x00, 0x78,
0x1F, 0x06, 0xF0, 0x0F, 0xC7, 0xF0, 0x07, 0xCF, 0xE0, 0x03, 0xCF, 0xC0, 0x01, 0xDF, 0x80, 0x00,
0x1F, 0x80, 0x00, 0x00, 0x00, 0x00, 0x00, 0x00, 
};

static unsigned char* PROGMEM runningAnimation[] = {running1, running4, running3, running2};

static unsigned int PROGMEM REFRIDGERATOR = 0;
static unsigned int PROGMEM WATER_PUMP = 1;

int activeSlide = 0;
unsigned long lastSlideChange = 0;

//static boolean PROGMEM slides[] = {REFRIDGERATOR, WATER_PUMP};

unsigned long lastRunningAnimateTime = 0;
int lastRunningAnimation = 0;

boolean refridgeratorOpen = false;
int refridgeratorTemperature = 0;
boolean refridgeratorRunning = false;
boolean refridgeratorOn = false;
boolean refridgeratorAlert = false;

boolean waterPumpOn = false;
boolean waterPumpRunning = false;
int waterTankLevel = 0;
int waterTemperature = 0;
boolean waterPumpAlert = false;

void setup() {
  Serial.begin(9600);
  pinMode(3, OUTPUT);
  analogWrite(3, 160);
  lcd.begin();
  
  lcd.setContrast(100);
  lcd.clearDisplay();
  lcd.drawBitmap(18, 0, vwLogo, 48, 48, BLACK);
  lcd.display();
  delay(2000);
}

void loop() {
  if (millis() - lastSlideChange > 10000) {
    activeSlide++;
    if (activeSlide == 2) activeSlide = 0;
    lastSlideChange = millis();
  }
  if(Serial.available() > 0) {
    if (Serial.read() == '<') {
      switch (Serial.read()) {
        case 'r':
          switch (Serial.read()) {
            case 'r':
              if (Serial.read() == '1') {
                refridgeratorRunning = true;
              } else {
                refridgeratorRunning = false;
              }
              break;
            case 'z':
              if (Serial.read() == '1') {
                refridgeratorOn = true;
              } else {
                refridgeratorOn = false;
              }
              break;
            case '!':
              if (Serial.read() == '1') {
                refridgeratorAlert = true;
              } else {
                refridgeratorAlert = false;
              }
              break;
            case 'd':
              if (Serial.read() == '1') {
                refridgeratorOpen = true;
              } else {
                refridgeratorOpen = false;
              }
              break;
            case 't':
              refridgeratorTemperature = receiveTemperature();
              break;
          }
          break;
        case 'w':
          switch (Serial.read()) {
            case 'r':
              if (Serial.read() == '1') {
                waterPumpRunning = true;
              } else {
                waterPumpRunning = false;
              }
              break;
            case 'z':
              if (Serial.read() == '1') {
                waterPumpOn = true;
              } else {
                waterPumpOn = false;
              }
              break;
            case '!':
              if (Serial.read() == '1') {
                waterPumpAlert = true;
              } else {
                waterPumpAlert = false;
              }
              break;
            case 'l':
              waterTankLevel = Serial.read();
              break;
            case 'f':
              break;
            case 't':
              waterTemperature = receiveTemperature();
              break;
          }
        break;
      }
    }
  }
    
  lcd.clearDisplay();
  //lcd.setTextSize(0);
  //lcd.print("\x91\x92\x9B\x9D\x86\x8F");
  //lcd.println("34 C");
  //lcd.print("Kj\x9Bleskap: ");
  //lcd.drawLine(0, 10, 50, 10, BLACK);
  //lcd.drawLine(0, 40, 50, 40, BLACK);
  //lcd.drawRect(0, 10, 20, 22, BLACK);
  //lcd.drawRect(14, 10, 3, 2, BLACK);
  //lcd.drawBitmap(0, 0, refridgerator, 32, 40, BLACK);
  //lcd.setTextSize(1);
  //lcd.setCursor(36, 0);
  //lcd.print(-23.3);
//  lcd.print((char)0xdf);
  //lcd.display();
  //delay(2000);
  //lcd.clearDisplay();
  if (activeSlide == REFRIDGERATOR) {
    if (!refridgeratorOn) drawOff();
    if (refridgeratorOpen) {
      lcd.drawBitmap(0, 0, refridgerator_open, 32, 48, BLACK);
    } else {
      lcd.drawBitmap(0, 0, refridgerator, 32, 40, BLACK);
    }
    //lcd.drawBitmap(0, 0, tank, 32, 40, BLACK);
    if (refridgeratorRunning) drawRunningAnimation();
    drawTemperature(refridgeratorTemperature);
    if (refridgeratorAlert) lcd.drawBitmap(35, 25, alertBitmap, 24, 21, BLACK);
  } else if (activeSlide == WATER_PUMP) {
    if (!waterPumpOn) drawOff();
    lcd.drawBitmap(0, 0, water_pump_on, 32, 40, BLACK);
    if (waterPumpRunning) drawRunningAnimation();
    drawTemperature(waterTemperature);
    if (waterPumpAlert) lcd.drawBitmap(35, 25, alertBitmap, 24, 21, BLACK);
    drawLevel(waterTankLevel);
  }
  lcd.display();
}

void drawRunningAnimation() {
  if (millis() - lastRunningAnimateTime > 300) {
    lastRunningAnimation++;
    if (lastRunningAnimation == 4) lastRunningAnimation = 0;
    lastRunningAnimateTime = millis();
  }
  lcd.drawBitmap(60, 24, runningAnimation[lastRunningAnimation], 24, 24, BLACK);
}

void drawTemperature(int temperature) {
  lcd.setTextSize(2);
  lcd.setCursor(36, 0);
  if (temperature >= 0 && temperature < 10000) lcd.print(" ");
  if (abs(temperature) < 1000) lcd.print(" ");
  String temp = String(temperature);
  lcd.print(temp.substring(0, temp.length() - 2));
  lcd.setTextSize(1);
  lcd.setCursor(72, 7);
  
  lcd.print(temp.substring(temp.length() - 2));
  lcd.drawCircle(74, 2, 2, BLACK);
}

void drawOff() {
  lcd.setTextSize(2);
  lcd.setCursor(48, 24);
  lcd.print("OFF");
}

int receiveTemperature() {
  byte byteRead;
  int num = 0;
  int negative = 1;
  while(Serial.available()) {
    byteRead = Serial.read();
    Serial.println(byteRead);
    if (byteRead == '-') {
      negative = -1;
    } else if (byteRead > 47 && byteRead < 58) {
      num = (num * 10) + (byteRead - 48);
    } else if (byteRead == '>') {
      break;
    }
  }
  Serial.println(negative * num);
  return negative * num;
}

void drawLevel(int percent) {
  lcd.drawRect(33, 15, 51, 8, BLACK);
  lcd.fillRect(33, 15, (percent / 100.0) * 51, 8, BLACK);
  //lcd.drawPixel(59, 16, BLACK);
  //lcd.drawPixel(59, 17, BLACK);
  lcd.drawPixel(58, 19, BLACK);
  lcd.drawPixel(58, 20, BLACK);
  lcd.drawPixel(58, 21, BLACK);
  lcd.drawPixel(45, 20, BLACK);
  lcd.drawPixel(45, 21, BLACK);
  lcd.drawPixel(70, 20, BLACK);
  lcd.drawPixel(70, 21, BLACK);
}
